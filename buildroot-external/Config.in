## buildroot-external/configs/cm4sen_defconfig
```kconfig
BR2_aarch64=y
BR2_cortex_a72=y
BR2_ARM_FPU_NEON_VFPV4=y

# 放补丁的位置
BR2_GLOBAL_PATCH_DIR="$(BR2_EXTERNAL_SMARTBOXOS_PATH)/patches $(BR2_EXTERNAL_SMARTBOXOS_PATH)/board/cm4sen/patches"

BR2_TOOLCHAIN_BUILDROOT_GLIBC=y
# GCC版本
BR2_GCC_VERSION_10_X=y
BR2_OPTIMIZE_2=y
BR2_SSP_REGULAR=y
BR2_SSP_OPTION="-fstack-protector"
BR2_TOOLCHAIN_BUILDROOT_CXX=y
BR2_BINUTILS_ENABLE_LTO=y
BR2_GCC_ENABLE_LTO=y

# 系统配置
BR2_TARGET_GENERIC_HOSTNAME="smartbox"
BR2_TARGET_GENERIC_ISSUE="Welcome to Smart Box OS"
BR2_INIT_SYSTEMD=y
BR2_TARGET_GENERIC_ROOT_PASSWD="www.ruixiaoedu.com"
# 使用BASH作为SH，会自动加入BASH包
BR2_SYSTEM_BIN_SH_BASH=y
BR2_TARGET_GENERIC_GETTY_PORT="tty1"
BR2_TARGET_LOCALTIME="Asia/Shanghai"
# 预先设置的根目录
BR2_ROOTFS_OVERLAY="$(BR2_EXTERNAL_SMARTBOXOS_PATH)/rootfs-overlay $(BR2_EXTERNAL_SMARTBOXOS_PATH)/board/cm4sen/rootfs-overlay"
# 在生成文件系统映像之前运行任意命令
BR2_ROOTFS_POST_BUILD_SCRIPT="$(BR2_EXTERNAL_SMARTBOXOS_PATH)/board/cm4sen/post-build.sh"
# 对最终生成的images进行打包处理等
BR2_ROOTFS_POST_IMAGE_SCRIPT="$(BR2_EXTERNAL_SMARTBOXOS_PATH)/board/cm4sen/post-image.sh"

#
# Linux 内核相关
#
BR2_LINUX_KERNEL=y
BR2_LINUX_KERNEL_CUSTOM_TARBALL=y
BR2_LINUX_KERNEL_CUSTOM_TARBALL_LOCATION="$(call github,raspberrypi,linux,581049d718caf95f5feb00607ac748d5841cf27c)/linux-581049d718caf95f5feb00607ac748d5841cf27c.tar.gz"
BR2_LINUX_KERNEL_DEFCONFIG="bcm2711"
BR2_LINUX_KERNEL_PATCH="$(BR2_EXTERNAL_SMARTBOXOS_PATH)/board/cm4sen/kernel-patches"
# 目前Linux内核配置先使用默认的配置
# BR2_LINUX_KERNEL_CONFIG_FRAGMENT_FILES="$(BR2_EXTERNAL_SMARTBOXOS_PATH)/kernel/smartbox.config $(BR2_EXTERNAL_SMARTBOXOS_PATH)/kernel/docker.config $(BR2_EXTERNAL_SMARTBOXOS_PATH)/kernel/device-support.config $(BR2_EXTERNAL_SMARTBOXOS_PATH)/board/cm4sen/kernel.config"
BR2_LINUX_KERNEL_CONFIG_FRAGMENT_FILES=""
# 内核压缩格式，暂时不选择
# BR2_LINUX_KERNEL_LZ4=y
BR2_LINUX_KERNEL_DTS_SUPPORT=y
BR2_LINUX_KERNEL_INTREE_DTS_NAME="broadcom/bcm2711-rpi-cm4"
BR2_LINUX_KERNEL_NEEDS_HOST_OPENSSL=y
# 需要主机安装libelf，按照Buildroot官方文档，貌似不需要
# BR2_LINUX_KERNEL_NEEDS_HOST_LIBELF=y

#
# BusyBox相关配置
#
BR2_PACKAGE_BUSYBOX=y
BR2_PACKAGE_BUSYBOX_CONFIG="$(BR2_EXTERNAL_SMARTBOXOS_PATH)/busybox.config" # 该处暂为Buildroot官方配置
# Busybox 作为单个二进制文件安装在 /bin/busybox 中，所有小程序都是到 /bin/busybox 的符号链接
# BR2_PACKAGE_BUSYBOX_INDIVIDUAL_BINARIES=y

# 标准信息实用程序和流程处理工具。 提供诸如 kill、ps、uptime、free、top 等内容。
BR2_PACKAGE_PROCPS_NG=y

# 此软件包为 LAN、WLAN 卡等设备提供各种二进制固件文件（闭源的二进制文件），目前树莓派不需要。
# BR2_PACKAGE_LINUX_FIRMWARE=y
# BR2_PACKAGE_LINUX_FIRMWARE_MEDIATEK_MT7601U=y
# BR2_PACKAGE_LINUX_FIRMWARE_RALINK_RT2XX=y
# BR2_PACKAGE_LINUX_FIRMWARE_RALINK_RT73=y
# BR2_PACKAGE_LINUX_FIRMWARE_RTL_87XX_BT=y
# BR2_PACKAGE_LINUX_FIRMWARE_RTL_88XX_BT=y
# BR2_PACKAGE_LINUX_FIRMWARE_USB_NIC_RTL_815X=y
# BR2_PACKAGE_LINUX_FIRMWARE_USB_SERIAL_TI=y

# 分区工具，暂时用不到，之后可能会用上
# BR2_PACKAGE_GPTFDISK=y
# BR2_PACKAGE_GPTFDISK_SGDISK=y

# CA证书，HTTPS都需要
BR2_PACKAGE_CA_CERTIFICATES=y

# sudo命令
BR2_PACKAGE_SUDO=y

# SSH连接
BR2_PACKAGE_OPENSSH=y

# 官方Linux Bluetooth栈
BR2_PACKAGE_BLUEZ5_UTILS=y
BR2_PACKAGE_BLUEZ5_UTILS_CLIENT=y
BR2_PACKAGE_BLUEZ5_UTILS_TOOLS=y

# DHCPCD
BR2_PACKAGE_DHCPCD=y

# 网络管理工具
BR2_PACKAGE_NETWORK_MANAGER=y
# 无线监管数据库，regulation.db等文件
BR2_PACKAGE_WIRELESS_REGDB=y

# Docker相关，暂时不加载docker
#BR2_PACKAGE_DOCKER_ENGINE=y
#BR2_PACKAGE_DOCKER_CLI=y
#BR2_PACKAGE_DOCKER_COMPOSE=y

# 生成硬件随机数
BR2_PACKAGE_RNG_TOOLS=y

# 
# systemd相关配置
# 
# BR2_PACKAGE_SYSTEMD_HWDB is not set
# BR2_PACKAGE_SYSTEMD_NETWORKD is not set
BR2_PACKAGE_SYSTEMD_RANDOMSEED=y
BR2_PACKAGE_SYSTEMD_RESOLVED=y
BR2_PACKAGE_SYSTEMD_COREDUMP=y
BR2_PACKAGE_SYSTEMD_JOURNAL_REMOTE=y
BR2_PACKAGE_SYSTEMD_LOGIND=y

# 分区实用工具
BR2_PACKAGE_UTIL_LINUX_PARTX=y

# mDNS服务
BR2_PACKAGE_AVAHI=y
BR2_PACKAGE_AVAHI_DAEMON=y

# 登录相关设置
BR2_PACKAGE_UTIL_LINUX_LOGIN=y
BR2_PACKAGE_UTIL_LINUX_NOLOGIN=y
BR2_PACKAGE_UTIL_LINUX_SULOGIN=y

# 一些 USB 设备（例如 3G/4G 宽带调制解调器）在大容量存储模式下启动，以提供对设备应用模式驱动程序的访问。具体不知啥，感觉有用，保留下来
BR2_PACKAGE_USB_MODESWITCH=y
BR2_PACKAGE_USB_MODESWITCH_DATA=y

#
# 文件系统，使用EXT2
#
BR2_TARGET_ROOTFS_EXT2=y
BR2_TARGET_ROOTFS_EXT2_4=y
BR2_TARGET_ROOTFS_EXT2_SIZE="300M"

BR2_PACKAGE_E2FSPROGS=y
BR2_PACKAGE_E2FSPROGS_RESIZE2FS=y
BR2_PACKAGE_PARTED=y

BR2_PACKAGE_UTIL_LINUX=y
BR2_PACKAGE_UTIL_LINUX_BINARIES=y

#
# UBOOT 启动相关，目前先不考虑UBOOT
#
# BR2_TARGET_UBOOT=y
# BR2_TARGET_UBOOT_BUILD_SYSTEM_KCONFIG=y
# BR2_TARGET_UBOOT_CUSTOM_VERSION=y
# BR2_TARGET_UBOOT_CUSTOM_VERSION_VALUE="2021.10"
# BR2_TARGET_UBOOT_BOARD_DEFCONFIG="rpi_4"
# BR2_TARGET_UBOOT_CONFIG_FRAGMENT_FILES="$(BR2_EXTERNAL_SMARTBOXOS_PATH)/bootloader/uboot.config $(BR2_EXTERNAL_SMARTBOXOS_PATH)/board/cm4sen/uboot.config $(BR2_EXTERNAL_SMARTBOXOS_PATH)/board/cm4sen/rpi4-64/uboot.config"
# BR2_PACKAGE_HOST_UBOOT_TOOLS=y
# BR2_PACKAGE_HOST_UBOOT_TOOLS_BOOT_SCRIPT=y
# BR2_PACKAGE_HOST_UBOOT_TOOLS_BOOT_SCRIPT_SOURCE="$(BR2_EXTERNAL_SMARTBOXOS_PATH)/board/cm4sen/uboot-boot64.ush"

# 内核头版本
BR2_PACKAGE_HOST_LINUX_HEADERS_CUSTOM_5_10=y

#
# 创建 SD 映像所需的工具
#
# 用于创建和检查 DOS FAT 文件系统的工具。
BR2_PACKAGE_HOST_DOSFSTOOLS=y
BR2_PACKAGE_HOST_GENIMAGE=y
# 编译的主机用的分区工具
# BR2_PACKAGE_HOST_GPTFDISK=y
# Mtools 是一个实用程序的集合，用于从 Unix 访问 MS-DOS 磁盘而无需挂载它们。
BR2_PACKAGE_HOST_MTOOLS=y

# curl程序，总会用到的
BR2_PACKAGE_LIBCURL_CURL=y
# 自定义的蓝牙组件，日后再打开
# BR2_PACKAGE_BLUETOOTH_BCM43XX=y

# 以下是树莓派相关固件，rpi-bt-firmware的蓝牙并不使用树莓派CM4
BR2_PACKAGE_RPI_FIRMWARE=y
BR2_PACKAGE_RPI_FIRMWARE_VARIANT_PI4=y
BR2_PACKAGE_RPI_FIRMWARE_CONFIG_FILE="$(BR2_EXTERNAL_SMARTBOXOS_PATH)/board/cm4sen/boot-overlay/config.txt"
BR2_PACKAGE_RPI_FIRMWARE_INSTALL_DTB_OVERLAYS=y     # TODO 查清用途
BR2_PACKAGE_RPI_WIFI_FIRMWARE=y

# 操作GPIO
BR2_PACKAGE_RASPI_GPIO=y

# 系统OTA升级
```

## buildroot-external/package/ota/Config.in
```kconfig
config BR2_PACKAGE_OTA
	bool "ota"
    depends on BR2_PACKAGE_HOST_GO_TARGET_ARCH_SUPPORTS
	depends on BR2_PACKAGE_HOST_GO_TARGET_CGO_LINKING_SUPPORTS
	depends on BR2_TOOLCHAIN_HAS_THREADS
    select BR2_PACKAGE_OPENSSL
    help
	  OTA is an open source over-the-air (OTA) software updater
	  for embedded Linux devices. OTA comprises a client
	  running at the embedded device, as well as a server that
	  manages deployments across many devices.


comment "ota needs a toolchain w/ threads"
	depends on BR2_PACKAGE_HOST_GO_TARGET_ARCH_SUPPORTS
	depends on BR2_PACKAGE_HOST_GO_TARGET_CGO_LINKING_SUPPORTS
	depends on !BR2_TOOLCHAIN_HAS_THREADS
```
